#include <SPI.h>
#include <Adafruit_GFX.h>
#include <Adafruit_ILI9341.h>
#include <XPT2046_Touchscreen.h>

// ====== Pines TFT (ajusta a tu cableado) ======
#define TFT_CS   5
#define TFT_DC   21
#define TFT_RST  4   // o -1 si tu módulo comparte el reset del ESP32

// ====== Pines Touch XPT2046 (ajusta a tu cableado) ======
// CS del touch suele ir a un pin distinto del CS del TFT
#define TOUCH_CS   2
#define TOUCH_IRQ  -1   // si no lo usas, pon -1

// ====== Objetos globales ======
Adafruit_ILI9341 tft(TFT_CS, TFT_DC, TFT_RST);
XPT2046_Touchscreen ts(TOUCH_CS, TOUCH_IRQ);

// ====== Calibración táctil (según tu petición) ======
#define TS_MINX 200
#define TS_MINY 200
#define TS_MAXX 3800
#define TS_MAXY 3800

// ====== Tamaño de pantalla según rotación ======
const int16_t SCR_W = 240;  // setRotation(0): ancho 240
const int16_t SCR_H = 320;  // setRotation(0): alto  320

// ====== Bitmaps (ejemplo: cambia por tus imágenes) ======
const unsigned char epd_bitmap_A[] PROGMEM = { 0x00, 0x00, 0x00, 0x00, 0x00, 0x00, 0x00, 0x00, 0x00, 0x00, 0x00, 0x00, 0x00, 0x00, 0x00, 0x00, 
	0x00, 0x00, 0x00, 0x00, 0x00, 0x00, 0x00, 0x00, 0x00, 0x00, 0x00, 0x00, 0x00, 0x00, 0x00, 0x00, 
	0x00, 0x00, 0x00, 0x00, 0x00, 0x00, 0x00, 0x00, 0x00, 0x00, 0x00, 0x00, 0x00, 0x00, 0x00, 0x00, 
	0x00, 0x00, 0x00, 0x00, 0x00, 0x00, 0x00, 0x00, 0x00, 0x00, 0x00, 0x00, 0x00, 0x00, 0x00, 0x00, 
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	0x00, 0x00, 0x00, 0x00, 0x00, 0x00, 0x00, 0x00, 0x00, 0x00, 0x00, 0x00, 0x00, 0x00, 0x00, 0x00};



const unsigned char epd_bitmap_B[] PROGMEM = {0x00, 0x00, 0x00, 0x00, 0x00, 0x00, 0x00, 0x00, 0x00, 0x00, 0x00, 0x00, 0x00, 0x00, 0x00, 0x00, 
	0x00, 0x00, 0x00, 0x00, 0x00, 0x00, 0x00, 0x00, 0x00, 0x00, 0x00, 0x00, 0x00, 0x00, 0x00, 0x00, 
	0x00, 0x00, 0x00, 0x00, 0x00, 0x00, 0x00, 0x00, 0x00, 0x00, 0x00, 0x00, 0x00, 0x00, 0x00, 0x00, 
	0x00, 0x00, 0x00, 0x00, 0x00, 0x00, 0x00, 0x00, 0x00, 0x00, 0x00, 0x00, 0x00, 0x00, 0x00, 0x00, 
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	0x00, 0x00, 0x00, 0x00, 0x00, 0x00, 0x00, 0x00, 0x00, 0x00, 0x00, 0x00, 0x00, 0x00, 0x00, 0x00};

// Estado actual: 0 = A, 1 = B
volatile uint8_t currentImg = 0;

// Anti-rebote / cooldown entre toques
unsigned long lastToggleMs = 0;
const unsigned long TOGGLE_COOLDOWN_MS = 250;

// ---------- Funciones auxiliares ----------

bool readTouchPoint(int16_t &x, int16_t &y) {
  if (!ts.touched()) return false;

  TS_Point p = ts.getPoint();

  // Mapear coordenadas RAW a pixeles
  int16_t sx = map(p.x, TS_MINX, TS_MAXX, 0, SCR_W - 1);
  int16_t sy = map(p.y, TS_MINY, TS_MAXY, 0, SCR_H - 1);

  // Si ves ejes invertidos, descomenta:
  // sx = SCR_W - 1 - sx;
  // sy = SCR_H - 1 - sy;

  x = sx;
  y = sy;
  return true;
}

void drawCurrentImage() {
  tft.fillScreen(ILI9341_WHITE);
  if (currentImg == 0) {
    tft.drawBitmap(0, 0, epd_bitmap_A, SCR_W, SCR_H, ILI9341_BLACK);
  } else {
    tft.drawBitmap(0, 0, epd_bitmap_B, SCR_W, SCR_H, ILI9341_BLACK);
  }
}

void toggleImage() {
  currentImg ^= 1;
  drawCurrentImage();
}

void waitForRelease() {
  // Espera a que se suelte el dedo
  unsigned long start = millis();
  while (ts.touched()) {
    delay(5);
    if (millis() - start > 1500) break;  // seguridad
  }
}

// ---------- Setup / Loop ----------

void setup() {
  SPI.begin();
  tft.begin();
  tft.setRotation(0);              // Retrato: 240x320
  tft.fillScreen(ILI9341_WHITE);

  ts.begin();
  ts.setRotation(0);               // hace match con el TFT

  drawCurrentImage();
}

void loop() {
  int16_t x, y;
  if (readTouchPoint(x, y)) {
    unsigned long now = millis();
    if (now - lastToggleMs > TOGGLE_COOLDOWN_MS) {
      toggleImage();
      lastToggleMs = now;
    }
    waitForRelease();
  }
  delay(5);
}
